## doc/Config_ditemx/config/boards/shields/iteMX/Kconfig.defconfig
```kconfig
    if SHIELD_diteMX_left

config ZMK_KEYBOARD_NAME
    default "ClavierMartinD"

config ZMK_SPLIT_ROLE_CENTRAL
    default y

endif

if SHIELD_diteMX_left || SHIELD_diteMX_right

config ZMK_SPLIT
    default y

endif
```

## doc/Config_ditemx/config/boards/shields/iteMX/Kconfig.shield
```kconfig
config SHIELD_diteMX_left
    def_bool $(shields_list_contains,diteMX_left)

config SHIELD_diteMX_right
    def_bool $(shields_list_contains,diteMX_right)
```
