## app/boards/arm/itemx/Kconfig.board
```kconfig
# SPDX-License-Identifier: Apache-2.0

config BOARD_ITEMX_NRF52840
	bool "ITEMX nRF52840"
	depends on SOC_NRF52840_QIAA
```

## app/boards/arm/itemx/Kconfig.defconfig
```kconfig
# SPDX-License-Identifier: Apache-2.0

if BOARD_ITEMX_NRF52840

config BOARD
	default "itemx_nrf52840"

config BT_CTLR
	default BT

config HW_STACK_PROTECTION
	default ARCH_HAS_STACK_PROTECTION

endif # BOARD_ITEMX_NRF52840
```

## app/boards/arm/itemx/itemx_nrf52840_defconfig
```kconfig
# SPDX-License-Identifier: Apache-2.0

CONFIG_SOC_SERIES_NRF52X=y
CONFIG_SOC_NRF52840_QIAA=y
CONFIG_BOARD_ITEMX_NRF52840=y

CONFIG_ARM_MPU=y
CONFIG_GPIO=y
CONFIG_SERIAL=y
CONFIG_ADC=y
CONFIG_SPI=y
CONFIG_WS2812_STRIP=y
CONFIG_REGULATOR=y
```

## app/boards/itemx/board.yml
```yaml
board:
  name: itemx
  full_name: ITEMX Split Keyboard Left
  vendor: custom
  socs:
  - name: nrf52840
```

## app/boards/itemx/itemx_nrf52840_defconfig
```kconfig
# SPDX-License-Identifier: Apache-2.0

# Enable MPU
CONFIG_ARM_MPU=y

# Enable GPIO
CONFIG_GPIO=y

# Enable ADC for battery monitoring
CONFIG_ADC=y

# Enable SPI for LED strip
CONFIG_SPI=y

# Enable LED strip driver
CONFIG_LED_STRIP=y
CONFIG_WS2812_STRIP_SPI=y

# Enable regulator driver for nPM1100
CONFIG_REGULATOR=y
```

## app/boards/shields/itemx/Kconfig.shield
```kconfig
# SPDX-License-Identifier: Apache-2.0

config SHIELD_ITEMX_LEFT
    def_bool $(shields_list_contains,itemx_left)

config SHIELD_ITEMX_RIGHT
    def_bool $(shields_list_contains,itemx_right)
```
